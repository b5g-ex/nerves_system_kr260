## Config.in
```kconfig
# Add project-specific packages for Buildroot here
#
# If these are non-proprietary, please consider contributing them back to
# Nerves or Buildroot.

source "$NERVES_DEFCONFIG_DIR/package/libdfx/Config.in"
source "$NERVES_DEFCONFIG_DIR/package/dfx-mgr/Config.in"
```

## nerves_defconfig
```kconfig
BR2_aarch64=y
BR2_TAR_OPTIONS="--no-same-owner"
BR2_ENABLE_DEBUG=y
BR2_OPTIMIZE_2=y
BR2_GLOBAL_PATCH_DIR="${BR2_EXTERNAL_NERVES_PATH}/patches"
BR2_REPRODUCIBLE=y
BR2_TOOLCHAIN_EXTERNAL=y
BR2_TOOLCHAIN_EXTERNAL_CUSTOM=y
BR2_TOOLCHAIN_EXTERNAL_DOWNLOAD=y
BR2_TOOLCHAIN_EXTERNAL_URL="https://github.com/nerves-project/toolchains/releases/download/v1.6.0/nerves_toolchain_aarch64_nerves_linux_gnu-linux_x86_64-1.6.0-DFCA48C.tar.xz"
BR2_TOOLCHAIN_EXTERNAL_CUSTOM_PREFIX="aarch64-nerves-linux-gnu"
BR2_TOOLCHAIN_EXTERNAL_GCC_11=y
BR2_TOOLCHAIN_EXTERNAL_HEADERS_4_19=y
BR2_TOOLCHAIN_EXTERNAL_CUSTOM_GLIBC=y
# BR2_TOOLCHAIN_EXTERNAL_INET_RPC is not set
BR2_TOOLCHAIN_EXTERNAL_CXX=y
BR2_TOOLCHAIN_EXTERNAL_OPENMP=y
BR2_ROOTFS_SKELETON_CUSTOM=y
BR2_ROOTFS_SKELETON_CUSTOM_PATH="${BR2_EXTERNAL_NERVES_PATH}/board/nerves-common/skeleton"
BR2_INIT_NONE=y
BR2_ROOTFS_DEVICE_TABLE="${BR2_EXTERNAL_NERVES_PATH}/board/nerves-common/device_table.txt"
BR2_ENABLE_LOCALE_WHITELIST="locale-archive"
BR2_GENERATE_LOCALE="en_US.UTF-8"
BR2_ROOTFS_OVERLAY="${BR2_EXTERNAL_NERVES_PATH}/board/nerves-common/rootfs_overlay ${NERVES_DEFCONFIG_DIR}/rootfs_overlay"
BR2_ROOTFS_POST_BUILD_SCRIPT="${NERVES_DEFCONFIG_DIR}/post-build.sh ${BR2_EXTERNAL_NERVES_PATH}/board/nerves-common/post-build.sh"
BR2_ROOTFS_POST_IMAGE_SCRIPT="${NERVES_DEFCONFIG_DIR}/post-createfs.sh"
BR2_LINUX_KERNEL=y
BR2_LINUX_KERNEL_CUSTOM_TARBALL=y
BR2_LINUX_KERNEL_CUSTOM_TARBALL_LOCATION="$(call github,Xilinx,linux-xlnx,xlnx_rebase_v5.15_LTS_2022.1_update2)/xlnx_rebase_v5.15_LTS_2022.1_update2.tar.gz"
BR2_LINUX_KERNEL_PATCH="${NERVES_DEFCONFIG_DIR}/linux/patches"
BR2_LINUX_KERNEL_USE_CUSTOM_CONFIG=y
BR2_LINUX_KERNEL_CUSTOM_CONFIG_FILE="${NERVES_DEFCONFIG_DIR}/linux/linux-5.15.defconfig"
BR2_LINUX_KERNEL_XZ=y
BR2_LINUX_KERNEL_DTS_SUPPORT=y
BR2_LINUX_KERNEL_INTREE_DTS_NAME="xilinx/smk-k26-revA-sck-kr-g-revB"
BR2_LINUX_KERNEL_NEEDS_HOST_OPENSSL=y
BR2_PACKAGE_BUSYBOX_CONFIG="${NERVES_DEFCONFIG_DIR}/busybox_defconfig"
BR2_PACKAGE_F2FS_TOOLS=y
BR2_PACKAGE_MESA3D=y
BR2_PACKAGE_MESA3D_GALLIUM_DRIVER_SWRAST=y
BR2_PACKAGE_MESA3D_GALLIUM_DRIVER_V3D=y
BR2_PACKAGE_MESA3D_OPENGL_ES=y
# BR2_PACKAGE_RNG_TOOLS_JITTERENTROPY_LIBRARY is not set
BR2_PACKAGE_LIBP11=y
BR2_PACKAGE_UNIXODBC=y
BR2_PACKAGE_LIBMNL=y
BR2_PACKAGE_WPA_SUPPLICANT=y
# BR2_TARGET_ROOTFS_TAR is not set
BR2_PACKAGE_HOST_UBOOT_TOOLS=y
BR2_PACKAGE_HOST_UBOOT_TOOLS_BOOT_SCRIPT=y
BR2_PACKAGE_HOST_UBOOT_TOOLS_BOOT_SCRIPT_SOURCE="${NERVES_DEFCONFIG_DIR}/uboot/boot.cmd"
BR2_NERVES_SYSTEM_NAME="nerves_system_kr260"
BR2_NERVES_ADDITIONAL_IMAGE_FILES="${NERVES_DEFCONFIG_DIR}/fwup.conf"
BR2_PACKAGE_NBTTY=y
BR2_PACKAGE_NERVES_CONFIG=y
BR2_PACKAGE_XMUTIL=y
BR2_PACKAGE_DFX_MGR=y
BR2_PACKAGE_AXI_QOS=y
BR2_PACKAGE_DDR_QOS=y
BR2_PACKAGE_IMAGE_UPDATE=y
BR2_PACKAGE_XLNX_PLATFORMSTATS=y
```

## package/dfx-mgr/Config.in
```kconfig
config BR2_PACKAGE_DFX_MGR
	bool "dfx-mgr"
	select BR2_PACKAGE_LIBDFX
	select BR2_PACKAGE_LIBWEBSOCKETS
	help
	  DFX-MGR provides infrastructure to abstract configuration and
	  hardware resource management for dynamic deployment of
	  Xilinx based accelerator across different platforms.
	  
	  https://github.com/Xilinx/dfx-mgr
```

## package/libdfx/Config.in
```kconfig
config BR2_PACKAGE_LIBDFX
	bool "libdfx"
	help
	  The library is a lightweight user-space library that provides
	  APIs for application to configure the PL.
	  
	  https://github.com/Xilinx/libdfx
```

## package/xmutil/Config.in
```kconfig
config BR2_PACKAGE_XMUTIL
	bool "xmutil"
	help
	  The different SOM tools.
	  This package provides tools, but not a wrapper script.

	  https://github.com/Xilinx/libdfx

config BR2_PACKAGE_XMUTIL_DEFAULT_TAG
	string "xmutil default git tag"
	depends on BR2_PACKAGE_XMUTIL
	default "xilinx_v2022.1_update2"
	help
	  Specify tools default tag name.

source "$NERVES_DEFCONFIG_DIR/package/xmutil/libdfx/Config.in"
source "$NERVES_DEFCONFIG_DIR/package/xmutil/dfx-mgr/Config.in"
```

## package/xmutil/axi-qos/Config.in
```kconfig
config BR2_PACKAGE_AXI_QOS
	bool "axi-qos"
	depends on BR2_PACKAGE_XMUTIL
	help
	  This application is to set QOS value for AXI ports
	  on ZYNQMP platform

	  https://github.com/Xilinx/axi-qos

config BR2_PACKAGE_AXI_QOS_USE_XMUTIL_TAG
	bool "use xmutil default tag"
	default y
	depends on BR2_PACKAGE_XMUTIL
	depends on BR2_PACKAGE_AXI_QOS

config BR2_PACKAGE_AXI_QOS_TAG
	string "axi-qos git tag"
	depends on BR2_PACKAGE_AXI_QOS
	depends on !BR2_PACKAGE_AXI_QOS_USE_XMUTIL_TAG
	help
	  Specify git tag
	  If empty BR2_PACKAGE_XMUTIL_DEFAULT_TAG is used

	  https://github.com/Xilinx/axi-qos
```

## package/xmutil/ddr-qos/Config.in
```kconfig
config BR2_PACKAGE_DDR_QOS
	bool "ddr-qos"
	depends on BR2_PACKAGE_XMUTIL
	help
	  This application is to set QOS value forDDR slots
	  on zynqmp platform

	  https://github.com/Xilinx/ddr-qos

config BR2_PACKAGE_DDR_QOS_USE_XMUTIL_TAG
	bool "use xmutil default tag"
	default y
	depends on BR2_PACKAGE_XMUTIL
	depends on BR2_PACKAGE_DDR_QOS

config BR2_PACKAGE_DDR_QOS_TAG
	string "ddr-qos git tag"
	depends on BR2_PACKAGE_DDR_QOS
	depends on !BR2_PACKAGE_DDR_QOS_USE_XMUTIL_TAG
	help
	  Specify git tag
	  If empty BR2_PACKAGE_XMUTIL_DEFAULT_TAG is used

	  https://github.com/Xilinx/ddr-qos
```

## package/xmutil/dfx-mgr/Config.in
```kconfig
config BR2_PACKAGE_DFX_MGR
	bool "dfx-mgr"
	depends on BR2_PACKAGE_XMUTIL
	select BR2_PACKAGE_LIBDFX
	select BR2_PACKAGE_LIBWEBSOCKETS
	help
	  DFX-MGR provides infrastructure to abstract configuration and
	  hardware resource management for dynamic deployment of
	  Xilinx based accelerator across different platforms.

	  https://github.com/Xilinx/dfx-mgr

config BR2_PACKAGE_DFX_MGR_USE_XMUTIL_TAG
	bool "use xmutil default tag"
	default y
	depends on BR2_PACKAGE_XMUTIL
	depends on BR2_PACKAGE_DFX_MGR

config BR2_PACKAGE_DFX_MGR_TAG
	string "dfx-mgr git tag"
	depends on BR2_PACKAGE_DFX_MGR
	depends on !BR2_PACKAGE_DFX_MGR_USE_XMUTIL_TAG
	help
	  Specify git tag
	  If empty BR2_PACKAGE_XMUTIL_DEFAULT_TAG is used

	  https://github.com/Xilinx/dfx-mgr
```

## package/xmutil/image_update/Config.in
```kconfig
config BR2_PACKAGE_IMAGE_UPDATE
	bool "image_update"
	depends on BR2_PACKAGE_XMUTIL
	help
	  This is a user space application that updates
	  the alternate image on QSPI while linux is running from
	  the current running image.

	  https://github.com/Xilinx/linux-image_update

config BR2_PACKAGE_IMAGE_UPDATE_USE_XMUTIL_TAG
	bool "use xmutil default tag"
	default y
	depends on BR2_PACKAGE_XMUTIL
	depends on BR2_PACKAGE_IMAGE_UPDATE

config BR2_PACKAGE_IMAGE_UPDATE_TAG
	string "image_update git tag"
	depends on BR2_PACKAGE_IMAGE_UPDATE
	depends on !BR2_PACKAGE_IMAGE_UPDATE_USE_XMUTIL_TAG
	help
	  Specify git tag
	  If empty BR2_PACKAGE_XMUTIL_DEFAULT_TAG is used

	  https://github.com/Xilinx/linux-image_update
```

## package/xmutil/libdfx/Config.in
```kconfig
config BR2_PACKAGE_LIBDFX
	bool "libdfx"
	depends on BR2_PACKAGE_XMUTIL
	help
	  The library is a lightweight user-space library that provides
	  APIs for application to configure the PL.

	  https://github.com/Xilinx/libdfx

config BR2_PACKAGE_LIBDFX_USE_XMUTIL_TAG
	bool "use xmutil default tag"
	default y
	depends on BR2_PACKAGE_XMUTIL
	depends on BR2_PACKAGE_LIBDFX

config BR2_PACKAGE_LIBDFX_TAG
	string "libdfx git tag"
	depends on BR2_PACKAGE_LIBDFX
	depends on !BR2_PACKAGE_LIBDFX_USE_XMUTIL_TAG
	help
	  Specify git tag
	  If empty BR2_PACKAGE_XMUTIL_DEFAULT_TAG is used

	  https://github.com/Xilinx/libdfx
```

## package/xmutil/xlnx_platformstats/Config.in
```kconfig
config BR2_PACKAGE_XLNX_PLATFORMSTATS
	bool "xlnx_platformstats"
	depends on BR2_PACKAGE_XMUTIL
	help
	  A library that provides APIs to print different platform statistics.

	  https://github.com/Xilinx/xlnx_platformstats

config BR2_PACKAGE_XLNX_PLATFORMSTATS_USE_XMUTIL_TAG
	bool "use xmutil default tag"
	default y
	depends on BR2_PACKAGE_XMUTIL
	depends on BR2_PACKAGE_XLNX_PLATFORMSTATS

config BR2_PACKAGE_XLNX_PLATFORMSTATS_TAG
	string "xlnx_platformstats git tag"
	depends on BR2_PACKAGE_XLNX_PLATFORMSTATS
	depends on !BR2_PACKAGE_XLNX_PLATFORMSTATS_USE_XMUTIL_TAG
	help
	  Specify git tag
	  If empty BR2_PACKAGE_XMUTIL_DEFAULT_TAG is used

	  https://github.com/Xilinx/xlnx_platformstats
```
